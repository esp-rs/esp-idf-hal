## .github/configs/sdkconfig.defaults
```kconfig
# Workaround for https://github.com/espressif/esp-idf/issues/7631
CONFIG_MBEDTLS_CERTIFICATE_BUNDLE=n
CONFIG_MBEDTLS_CERTIFICATE_BUNDLE_DEFAULT_FULL=n
```

## esp-idf-hal/.github/configs/sdkconfig.defaults
```kconfig
# Workaround for https://github.com/espressif/esp-idf/issues/7631
#CONFIG_MBEDTLS_CERTIFICATE_BUNDLE=n
#CONFIG_MBEDTLS_CERTIFICATE_BUNDLE_DEFAULT_FULL=n

# Some examples (ledc_simple, spi_loopback_async) require a larger than the default stack size for
# the main thread.
CONFIG_ESP_MAIN_TASK_STACK_SIZE=8000

# Async SPI only enabled when this config is disabled (it is enabled by default)
CONFIG_SPI_MASTER_ISR_IN_IRAM=n
```

## esp-idf-svc/.github/configs/sdkconfig.defaults
```kconfig
CONFIG_MBEDTLS_CERTIFICATE_BUNDLE=y
CONFIG_MBEDTLS_CERTIFICATE_BUNDLE_DEFAULT_FULL=y

# Examples often require a larger than the default stack size for the main thread and for the sysloop event task.
# Necessary when the `embassy-time-driver` feature is enabled
CONFIG_ESP_TIMER_TASK_STACK_SIZE=4096
CONFIG_ESP_MAIN_TASK_STACK_SIZE=20000
CONFIG_ESP_SYSTEM_EVENT_TASK_STACK_SIZE=8192
CONFIG_PTHREAD_TASK_STACK_SIZE_DEFAULT=8192

# Go figure...
CONFIG_FREERTOS_IDLE_TASK_STACKSIZE=4096

# Enable WS support
CONFIG_HTTPD_WS_SUPPORT=y

# SPI Ethernet demo
CONFIG_ETH_SPI_ETHERNET_DM9051=y
CONFIG_ETH_SPI_ETHERNET_W5500=y
CONFIG_ETH_SPI_ETHERNET_KSZ8851SNL=y

# We don't have an example for classic BT - yet - we need to enable class BT
# specifically to workaround this bug in ESP IDF v5.2 (fixed in ESP IDF v5.2.1+):
# https://github.com/espressif/esp-idf/issues/13113
CONFIG_BT_CLASSIC_ENABLED=y

# BLE with Bluedroid
CONFIG_BT_ENABLED=y
CONFIG_BT_BLUEDROID_ENABLED=y
CONFIG_BTDM_CTRL_MODE_BLE_ONLY=y
CONFIG_BTDM_CTRL_MODE_BR_EDR_ONLY=n
CONFIG_BTDM_CTRL_MODE_BTDM=n
CONFIG_BT_BLE_42_FEATURES_SUPPORTED=y
CONFIG_BT_BLE_50_FEATURES_SUPPORTED=n
CONFIG_BT_BTC_TASK_STACK_SIZE=15000
CONFIG_BT_BLE_DYNAMIC_ENV_MEMORY=y

# Support for TLS with a pre-shared key.
#CONFIG_ESP_TLS_PSK_VERIFICATION=y

CONFIG_LWIP_PPP_SUPPORT=y
#CONFIG_LWIP_SLIP_SUPPORT=y

# Generic Thread functionality
CONFIG_OPENTHREAD_ENABLED=y

# Thread Border Router
#CONFIG_OPENTHREAD_BORDER_ROUTER=y

# These are also necessary for the Joiner feature
#CONFIG_MBEDTLS_CMAC_C=y
#CONFIG_MBEDTLS_SSL_PROTO_DTLS=y
#CONFIG_MBEDTLS_KEY_EXCHANGE_ECJPAKE=y
#CONFIG_MBEDTLS_ECJPAKE_C=y

# Border Router again, LWIP
#CONFIG_LWIP_IPV6_NUM_ADDRESSES=12
#CONFIG_LWIP_NETIF_STATUS_CALLBACK=y
#CONFIG_LWIP_IPV6_FORWARD=y
#CONFIG_LWIP_MULTICAST_PING=y
#CONFIG_LWIP_NETIF_STATUS_CALLBACK=y
#CONFIG_LWIP_HOOK_IP6_ROUTE_DEFAULT=y
#CONFIG_LWIP_HOOK_ND6_GET_GW_DEFAULT=y
#CONFIG_LWIP_HOOK_IP6_INPUT_CUSTOM=y
#CONFIG_LWIP_HOOK_IP6_SELECT_SRC_ADDR_CUSTOM=y
#CONFIG_LWIP_IPV6_AUTOCONFIG=y
#CONFIG_LWIP_TCPIP_TASK_STACK_SIZE=4096

# Border Router again, mDNS
#CONFIG_MDNS_MULTIPLE_INSTANCE=y

# Littlefs on SD cards example
#CONFIG_LITTLEFS_SDMMC_SUPPORT=y
```

## esp-idf-sys/.github/configs/sdkconfig.defaults
```kconfig
# The examples require a larger than the default stack size for the main thread and the posix threads.
CONFIG_ESP_MAIN_TASK_STACK_SIZE=20000
CONFIG_PTHREAD_TASK_STACK_SIZE_DEFAULT=8192

# Go figure...
CONFIG_FREERTOS_IDLE_TASK_STACKSIZE=4096

# OpenThread support
CONFIG_OPENTHREAD_ENABLED=y

# Suppress deprecation warnings for legacy drivers still included in bindings
CONFIG_I2C_SUPPRESS_DEPRECATE_WARN=y
CONFIG_TWAI_SUPPRESS_DEPRECATE_WARN=y
CONFIG_TOUCH_SUPPRESS_DEPRECATE_WARN=y
```
